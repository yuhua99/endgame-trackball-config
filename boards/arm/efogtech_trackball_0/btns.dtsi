/*
 * Copyright (c) 2020 The ZMK Contributors
 *
 * SPDX-License-Identifier: MIT
 */


/ {
    btns: connector {
        compatible = "efogtech-trackball-0";
        #gpio-cells = <2>;
        gpio-map-mask = <0xffffffff 0xffffffc0>;
        gpio-map-pass-thru = <0 0x3f>;
        gpio-map
            = <0 0 &gpio0 26 0>      /* D0 */
            , <1 0 &gpio0 27 0>      /* D1 */
            , <2 0 &gpio0 1 0>     /* D2 */
            , <3 0 &gpio0 21 0>     /* D3 */
            , <4 0 &gpio0 8 0>     /* D4/A6 */
            , <5 0 &gpio0 7 0>     /* D5 */
            , <6 0 &gpio0 5 0>     /* D6/A7 */
            , <7 0 &gpio0 4 0>      /* D7 */
            ;
    };
};
