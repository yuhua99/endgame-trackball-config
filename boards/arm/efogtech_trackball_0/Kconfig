## boards/arm/efogtech_trackball_0/Kconfig
```kconfig
config BOARD_ENABLE_DCDC
    bool "Enable DCDC mode"
    select SOC_DCDC_NRF52X
    default n
    depends on BOARD_EFOGTECH_TRBL_52833

config BOARD_NRFMICRO_CHARGER
    bool "Enable battery charger"
    default n
    depends on BOARD_EFOGTECH_TRBL_52833
```

## boards/arm/efogtech_trackball_0/Kconfig.board
```kconfig
config BOARD_EFOGTECH_TRBL_52833
    bool "efogtech_trackball_0"
    depends on SOC_NRF52833_QIAA
```

## boards/arm/efogtech_trackball_0/Kconfig.defconfig
```kconfig
# Electronut Labs Papyr board configuration

# Copyright (c) 2020 The ZMK Contributors
# SPDX-License-Identifier: MIT

if BOARD_EFOGTECH_TRBL_52833

config BOARD
    default "efogtech_trackball_0"

config ZMK_KEYBOARD_NAME
    default "Trackball"

config EC11
    default y

if USB_DEVICE_STACK

config USB_NRFX
    default y

endif # USB_DEVICE_STACK

config PWM
    default y

config LED_PWM
    default y

config SPI
    default y

config BT_CTLR
    default BT

endif # BOARD_EFOGTECH_TRBL_52833
```

## boards/arm/efogtech_trackball_0/efogtech_trackball_0_defconfig
```kconfig
# SPDX-License-Identifier: MIT

CONFIG_SOC_SERIES_NRF52X=y
CONFIG_SOC_NRF52833_QIAA=y
CONFIG_BOARD_EFOGTECH_TRBL_52833=y
CONFIG_PMW3610=y
CONFIG_ARM_MPU=y
CONFIG_SERIAL=y
CONFIG_USE_DT_CODE_PARTITION=y
CONFIG_BUILD_OUTPUT_UF2=y
CONFIG_MPU_ALLOW_FLASH_WRITE=y
CONFIG_NVS=y
CONFIG_SETTINGS_NVS=y
CONFIG_FLASH=y
CONFIG_FLASH_PAGE_LAYOUT=y
CONFIG_FLASH_MAP=y
CONFIG_CLOCK_CONTROL_NRF=y
CONFIG_CLOCK_CONTROL_NRF_K32SRC_RC=y
CONFIG_ZMK_USB=y
CONFIG_ZMK_BLE=y
CONFIG_INPUT=y
CONFIG_ZMK_POINTING=y
CONFIG_WS2812_STRIP=y
CONFIG_ZMK_BACKLIGHT=y
CONFIG_PWM=y
CONFIG_LED_PWM=y
CONFIG_LOG_SPEED=y
CONFIG_SIZE_OPTIMIZATIONS=n
CONFIG_SPEED_OPTIMIZATIONS=y
CONFIG_ZMK_USB_LOGGING=n
CONFIG_LOG_MAX_LEVEL=3
CONFIG_LOG_PROCESS_THREAD_STARTUP_DELAY_MS=0
CONFIG_SPI=y
CONFIG_SPI_ASYNC=y
CONFIG_PWM=y
CONFIG_INPUT=y
CONFIG_GPIO=y
CONFIG_PINCTRL=y
CONFIG_EC11=y
CONFIG_EC11_TRIGGER_GLOBAL_THREAD=y
CONFIG_ACPI_HID_LEN_MAX=24
CONFIG_NRF_STORE_REBOOT_TYPE_GPREGRET=n
CONFIG_CBPRINTF_FP_SUPPORT=n
CONFIG_USB_HID_POLL_INTERVAL_MS=1
CONFIG_SERIAL=y
CONFIG_UART_INTERRUPT_DRIVEN=y
CONFIG_USB_DEVICE_VID=0x0011
CONFIG_USB_DEVICE_PID=0x0006
CONFIG_USB_DEVICE_MANUFACTURER="efog.tech"
CONFIG_ZMK_BLE_MOUSE_REPORT_QUEUE_SIZE=1
CONFIG_ZMK_BLE_EXPERIMENTAL_CONN=y
CONFIG_ZMK_BLE_EXPERIMENTAL_SEC=y
CONFIG_ZMK_BLE_EXPERIMENTAL_FEATURES=y
CONFIG_ZMK_BLE_PASSKEY_ENTRY=n
CONFIG_BT_CTLR_TX_PWR_PLUS_8=y
CONFIG_BT_CTLR_CONN_RSSI=y
CONFIG_BT_CTLR_TX_PWR_DYNAMIC_CONTROL=y
CONFIG_BT_CTLR_PHY_2M=y
CONFIG_BT_PERIPHERAL_PREF_MAX_INT=6
CONFIG_BT_TPS=y
CONFIG_BT_GATT_ENFORCE_SUBSCRIPTION=y
CONFIG_ZMK_POINTER_2S_MIXER=y
CONFIG_PMW3610_INIT_POWER_UP_EXTRA_DELAY_MS=10
CONFIG_PMW3610_REPORT_INTERVAL_MIN=0
CONFIG_PMW3610_SMART_ALGORITHM=y
CONFIG_PMW3610_SQUAL_LOG=n
CONFIG_PMW3610_SQUAL_LOG_INTERVAL=250
CONFIG_ZMK_RGB_UNDERGLOW_EXT_POWER=n
CONFIG_WS2812_STRIP=y
CONFIG_NFCT_PINS_AS_GPIOS=y
```

## boards/shields/trackball-rev01/Kconfig.defconfig
```kconfig
if SHIELD_trackball-rev01

config ZMK_KEYBOARD_NAME
    default "trackball-rev01"

endif

config SPI
	default y
```

## boards/shields/trackball-rev01/Kconfig.shield
```kconfig
config SHIELD_trackball-rev01
    def_bool $(shields_list_contains,trackball-rev01)
```

## boards/shields/trackball_rev01/Kconfig.defconfig
```kconfig
if SHIELD_TRACKBALL_REV01

config ZMK_KEYBOARD_NAME
    default "trackball_rev01"

endif

config SPI
	default y
```

## boards/shields/trackball_rev01/Kconfig.shield
```kconfig
config SHIELD_TRACKBALL_REV01
    def_bool $(shields_list_contains,trackball_rev01)
```

## boards/shields/trbl_rev01/Kconfig.defconfig
```kconfig
if SHIELD_TRACKBALL_REV01

config ZMK_KEYBOARD_NAME
    default "Trackball"

config EC11
    default y

endif # SHIELD_TRACKBALL_REV01

if ZMK_BACKLIGHT

config PWM
    default y

config LED_PWM
    default y

endif # ZMK_BACKLIGHT

config SPI
	default y
```

## config/west.yml
```yaml
manifest:
  remotes:
    - name: zmkfirmware
      url-base: https://github.com/zmkfirmware
    - name: efogdev
      url-base: https://github.com/efogdev
  projects:
    - name: zmk
      remote: zmkfirmware
      revision: main
      import: app/west.yml
    - name: zmk-pmw3610-driver
      remote: efogdev
      revision: main
  self:
    path: config
```
